#include "Includes.h"
#include "gui.h"
#include "progbar.h"
#include "DIALOG.h"

extern TouchPos TouchXY;

extern volatile U8 i_menu ;
extern volatile U8 alarm_on;

extern U16 height_pingtan;
extern U16 height_ningling ;
extern U16 height_kanke ;
//$$$$$$$$$$$$$$$$$$$$$$$$$$$$$$$$$$$$$$$$$$$$$$$$$$$$$$$$$$$$$$$$$$$$$$$$$$$//
//$$$$$$$$$$$$$$$$$$$$$$$$$$$$$$$$$$$$$$$$$$$$$$$$$$$$$$$$$$$$$$$$$$$$$$$$$$$//
//$$$$$$$$$$$$$$$$$$$$$$$$$$$$$$$$$$$$$$$$$$$$$$$$$$$$$$$$$$$$$$$$$$$$$$$$$$$//

#define countof(Obj) (sizeof(Obj)/sizeof(Obj[0]))
#define DEG2RAD      (3.1415926f/180)

/*******************************************************************
*
*                       Scale bitmap
*
********************************************************************
*/

static const GUI_COLOR ColorsScaleR140[] = {
  0x000000,0x00AA00,0xFFFFFF,0x0000AA,
  0x00FF00,0xAEAEAE,0x737373,0xD3D3D3,
  0xDFDFDF,0xBBDFBB,0x6161DF,0x61DF61,
  0xBBBBDF,0xC7C7C7,0x616193
};

static const GUI_LOGPALETTE PalScaleR140 = {
  15,	/* number of entries */
  0, 	/* No transparency */
  &ColorsScaleR140[0]
};

static const unsigned char acScaleR140[] = {
  0x00, 0x00, 0x00, 0x00, 0x00, 0x00, 0x00, 0x00, 0x00, 0x00, 0x00, 0x00,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 0x00,
  0x00, 0x00, 0x00, 0x00, 0x00, 0x00, 0x00, 0x00, 0x00, 0x00, 0x00, 0x00,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 0x00,
  0x00, 0x00, 0x00, 0x00, 0x00, 0x00, 0x00, 0x00, 0x00, 0x00, 0x00, 0x00,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 0x00,
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  0x00, 0x00, 0x00, 0x00, 0x00, 0x00, 0x00, 0x00, 0x00, 0x00, 0x00, 0x00,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 0x00
};

static const GUI_BITMAP bmScaleR140 = {
 200,          /* XSize */
 73,           /* YSize */
 100,          /* BytesPerLine */
 4,            /* BitsPerPixel */
 acScaleR140,  /* Pointer to picture data (indices) */
 &PalScaleR140 /* Pointer to palette */
};

/*******************************************************************
*
*                    Shape of polygon
*
********************************************************************
*/

#define MAG 3

static const GUI_POINT aNeedle[] = {
  { MAG * ( 0), MAG * (  0 + 125)},
  { MAG * (-3), MAG * (-15 + 125)},
  { MAG * (-3), MAG * (-65 + 125)},
  { MAG * ( 3), MAG * (-65 + 125)},
  { MAG * ( 3), MAG * (-15 + 125)},
};

/*******************************************************************
*
*      Structure containing information for drawing routine
*
*******************************************************************
*/

typedef struct {
  /* Information about what has to be displayed */
  GUI_AUTODEV_INFO AutoDevInfo;
  /* Polygon data */
  GUI_POINT aPoints[7];
  float Angle;
} PARAM;

/*******************************************************************
*
*                     GetAngle
*
********************************************************************

This routine returns the value value to indicate. In a real application,
this value would somehow be measured.
*/

static float GetAngle(float tDiff) {
  if (tDiff < 15000) {
    return  225 - 0.006 * tDiff ;
  }
  tDiff -= 15000;
  if (tDiff < 7500) {
    return  225 - 90 + 0.012 * tDiff ;
  }
  tDiff -= 7000;
  return 225;
}

/*******************************************************************
*
*                     Drawing routine
*
********************************************************************
*/

static void Draw(void * p) {
  PARAM * pParam = (PARAM *)p;
  /* Fixed background */
  if (pParam->AutoDevInfo.DrawFixed) {
    GUI_ClearRect (25, 50 + bmScaleR140.YSize, 60 + bmScaleR140.XSize - 1, 150);
    //GUI_DrawBitmap(&bmScaleR140, 60, 50);
      GUI_DrawBitmap(&bmScaleR140, 25, 50);
  }
  /* Moving needle */
  GUI_SetColor(GUI_WHITE);
  GUI_AA_FillPolygon(pParam->aPoints, countof(aNeedle), MAG * 125, MAG * 190);
  /* Fixed foreground */
  if (pParam->AutoDevInfo.DrawFixed) {
    GUI_SetTextMode(GUI_TM_TRANS);
    GUI_SetColor(GUI_RED);
    GUI_SetFont(&GUI_Font24B_ASCII);
    GUI_DispStringHCenterAt("RPM / 1000", 125, 110);
  }
}

/*******************************************************************
*
*  Shows a scale with a needle using a banding memory device
*
********************************************************************
*/

 void DemoScale(float tDiff) {
  int Cnt;
  //int  t0 = GUI_GetTime();
  PARAM Param;            /* Parameters for drawing routine */
  GUI_AUTODEV AutoDev;    /* Object for banding memory device */
  /* Show message */
  GUI_SetColor(GUI_WHITE);
 // GUI_SetFont(&GUI_Font8x16);
  //GUI_DispStringHCenterAt("Scale using GUI_AUTODEV-object", 120, 0);
  /* Enable high resolution for antialiasing */
  GUI_AA_EnableHiRes();
  GUI_AA_SetFactor(MAG);
  /* Create GUI_AUTODEV-object */
  GUI_MEMDEV_CreateAuto(&AutoDev);
  /* Show needle for a fixed time */
  //for (Cnt = 0; (tDiff = GUI_GetTime() - t0) < 24000; Cnt++) {
    /* Get value to display an calculate polygon for needle  */
    
    Param.Angle = GetAngle(tDiff*200)* DEG2RAD;
    GUI_RotatePolygon(Param.aPoints, aNeedle, countof(aNeedle), Param.Angle);
    GUI_MEMDEV_DrawAuto(&AutoDev, &Param.AutoDevInfo, &Draw, &Param);
  //}
  /* Display milliseconds / picture */
  //GUI_SetColor(GUI_WHITE);
  //GUI_SetFont(&GUI_Font8x16);
  //GUI_DispStringHCenterAt("Milliseconds / picture:", 120, 180);
  //GUI_SetTextAlign(GUI_TA_CENTER);
  //GUI_SetTextMode(GUI_TM_NORMAL);
  //GUI_DispNextLine();
  //GUI_GotoX(160);
  //GUI_DispFloatMin((float)tDiff / (float)Cnt, 2);
  /* Delete GUI_AUTODEV-object */
  GUI_MEMDEV_DeleteAuto(&AutoDev);
} 




//$$$$$$$$$$$$$$$$$$$$$$$$$$$$$$$$$$$$$$$$$$$$$$$$$$$$$$$$$$$$$$$$$$$$$$$$$$$//
//$$$$$$$$$$$$$$$$$$$$$$$$$$$$$$$$$$$$$$$$$$$$$$$$$$$$$$$$$$$$$$$$$$$$$$$$$$$//
//$$$$$$$$$$$$$$$$$$$$$$$$$$$$$$$$$$$$$$$$$$$$$$$$$$$$$$$$$$$$$$$$$$$$$$$$$$$//
extern volatile float hightest_speed_pingtan;

/*******************************************************************
*
*       DemoProgBar
*/

 void DemoProgBar(float value) {
 
  int i;
  PROGBAR_Handle ahProgBar;

  GUI_SetColor(GUI_WHITE);
  GUI_SetFont(&GUI_Font8x16);
  GUI_DispDecAt((int)hightest_speed_kanke, 202,243,3);
  GUI_DispStringAt("max", 202,228);
  GUI_SetFont(& GUI_FontHZ16);
  GUI_SetColor(GUI_GREEN);
  GUI_DispStringAt("速度限制:", 20,243);
  
  /* Create the progbars */  
  ahProgBar = PROGBAR_Create(100,240,100,20, WM_CF_SHOW);
  PROGBAR_SetBarColor(ahProgBar, 0, GUI_GREEN);
  PROGBAR_SetBarColor(ahProgBar, 1, GUI_GRAY);
  PROGBAR_SetMinMax(ahProgBar, 0, (int)hightest_speed_kanke);

  /* Use memory device (optional, for better looks) */
  PROGBAR_EnableMemdev(ahProgBar);
  
    
    //for (i=0; i<=100; i++) 
    //{
      PROGBAR_SetValue(ahProgBar, (int)value);
      GUI_Exec();
      //GUI_Delay(1);
    //}
      PROGBAR_Delete(ahProgBar);

}


//$$$$$$$$$$$$$$$$$$$$$$$$$$$$$$$$$$$$$$$$$$$$$$$$$$$$$$$$$$$$$$$$$$$$$$$$$$$//
//$$$$$$$$$$$$$$$$$$$$$$$$$$$$$$$$$$$$$$$$$$$$$$$$$$$$$$$$$$$$$$$$$$$$$$$$$$$//
//$$$$$$$$$$$$$$$$$$$$$$$$$$$$$$$$$$$$$$$$$$$$$$$$$$$$$$$$$$$$$$$$$$$$$$$$$$$//


 void DemoProgBar2(int value) {
 
  int i;
  PROGBAR_Handle ahProgBar;
  
  GUI_SetFont(& GUI_FontHZ16);
  GUI_SetColor(GUI_GREEN);
  GUI_DispStringAt("路面抖动:" , 20, 280 );
  GUI_SetColor(GUI_WHITE);
  GUI_SetFont(&GUI_Font8x16);
  GUI_DispDecAt((int)height_pingtan, 222,280,2);
  
  /* Create the progbars */  
  ahProgBar = PROGBAR_Create(100,280,120,20, WM_CF_SHOW);
  PROGBAR_SetBarColor(ahProgBar, 0, GUI_RED);
  PROGBAR_SetBarColor(ahProgBar, 1, GUI_GRAY);
  PROGBAR_SetMinMax(ahProgBar, 0, height_pingtan);

  /* Use memory device (optional, for better looks) */
  PROGBAR_EnableMemdev(ahProgBar);
  
      PROGBAR_SetValue(ahProgBar, (int)value);
      GUI_Exec();

      PROGBAR_Delete(ahProgBar);

}



//$$$$$$$$$$$$$$$$$$$$$$$$$$$$$$$$$$$$$$$$$$$$$$$$$$$$$$$$$$$$$$$$$$$$$$$$$$$//
//$$$$$$$$$$$$$$$$$$$$$$$$$$$$$$$$$$$$$$$$$$$$$$$$$$$$$$$$$$$$$$$$$$$$$$$$$$$//
//$$$$$$$$$$$$$$$$$$$$$$$$$$$$$$$$$$$$$$$$$$$$$$$$$$$$$$$$$$$$$$$$$$$$$$$$$$$//


static const GUI_ConstString _apListBox[] = {
  "English", "Deutsch", "Fran", "Japanese", "Italiano", NULL
};

static void _cbCallback1(WM_MESSAGE * pMsg) {
  int NCode, Id;
  WM_HWIN hEdit0, hEdit1, hEdit2, hEdit3, hListBox;
  WM_HWIN hWin = pMsg->hWin;
  switch (pMsg->MsgId) {
    case WM_INIT_DIALOG:
      /* Get window handles for all widgets */
      hEdit0   = WM_GetDialogItem(hWin, GUI_ID_EDIT0);
      hEdit1   = WM_GetDialogItem(hWin, GUI_ID_EDIT1);
      hEdit2   = WM_GetDialogItem(hWin, GUI_ID_EDIT2);
      hEdit3   = WM_GetDialogItem(hWin, GUI_ID_EDIT3);
      hListBox = WM_GetDialogItem(hWin, GUI_ID_LISTBOX0);
      /* Initialize all widgets */
      EDIT_SetText(hEdit0, "EDIT widget 0");
      EDIT_SetText(hEdit1, "EDIT widget 1");
      EDIT_SetTextAlign(hEdit1, GUI_TA_LEFT);
      EDIT_SetHexMode(hEdit2, 0x1234, 0, 0xffff);
      EDIT_SetBinMode(hEdit3, 0x1234, 0, 0xffff);
      LISTBOX_SetText(hListBox, _apListBox);
      WM_DisableWindow (WM_GetDialogItem(hWin, GUI_ID_CHECK1));
      CHECKBOX_Check(  WM_GetDialogItem(hWin, GUI_ID_CHECK0));
      CHECKBOX_Check(  WM_GetDialogItem(hWin, GUI_ID_CHECK1));
      SLIDER_SetWidth( WM_GetDialogItem(hWin, GUI_ID_SLIDER0), 5);
      SLIDER_SetValue( WM_GetDialogItem(hWin, GUI_ID_SLIDER1), 50);
      SCROLLBAR_CreateAttached(hListBox, SCROLLBAR_CF_VERTICAL);
      break;
    case WM_KEY:
      switch (((WM_KEY_INFO*)(pMsg->Data.p))->Key) {
      case GUI_KEY_ESCAPE:
        GUI_EndDialog(hWin, 1);
        break;
      case GUI_KEY_ENTER:
        GUI_EndDialog(hWin, 0);
        break;
      }
      break;
    case WM_NOTIFY_PARENT:
      Id    = WM_GetId(pMsg->hWinSrc);    /* Id of widget */
      NCode = pMsg->Data.v;               /* Notification code */
      switch (NCode) {
        case WM_NOTIFICATION_RELEASED:    /* React only if released */
          if (Id == GUI_ID_OK) {          /* OK Button */
            GUI_EndDialog(hWin, 0);
          }
          if (Id == GUI_ID_CANCEL) {      /* Cancel Button */
            GUI_EndDialog(hWin, 1);
          }
          break;
      }
      break;
    default:
      WM_DefaultProc(pMsg);
  }
}

static const GUI_WIDGET_CREATE_INFO _aDialogCreate1[] = {
  { FRAMEWIN_CreateIndirect, "Setting", 0,              10,  10, 220, 300, FRAMEWIN_CF_MOVEABLE, 0  },
  { BUTTON_CreateIndirect,   "OK",     GUI_ID_OK,     100,  5,   60,  20 },
  { BUTTON_CreateIndirect,   "Cancel", GUI_ID_CANCEL, 100,  30,  60,  20 },
  { TEXT_CreateIndirect,     "LText",  0,              10,  55,  48,  15, TEXT_CF_LEFT  },
  { TEXT_CreateIndirect,     "RText",  0,              10,  80,  48,  15, TEXT_CF_RIGHT },
  { EDIT_CreateIndirect,     NULL,     GUI_ID_EDIT0,   60,  55, 100,  15, 0, 50 },
  { EDIT_CreateIndirect,     NULL,     GUI_ID_EDIT1,   60,  80, 100,  15, 0, 50 },
  { TEXT_CreateIndirect,     "Hex",    0,              10, 100,  48,  15, TEXT_CF_RIGHT },
  { EDIT_CreateIndirect,     NULL,     GUI_ID_EDIT2,   60, 100, 100,  15, 0, 6 },
  { TEXT_CreateIndirect,     "Bin",    0,              10, 120,  48,  15, TEXT_CF_RIGHT },
  { EDIT_CreateIndirect,     NULL,     GUI_ID_EDIT3,   60, 120, 100,  15 },
  { LISTBOX_CreateIndirect,  NULL,     GUI_ID_LISTBOX0,10,  10,  60,  40 },
  { CHECKBOX_CreateIndirect, NULL,     GUI_ID_CHECK0,  10, 140,   0,   0 },
  { CHECKBOX_CreateIndirect, NULL,     GUI_ID_CHECK1,  30, 140,   0,   0 },
  { SLIDER_CreateIndirect,   NULL,     GUI_ID_SLIDER0, 60, 140, 100,  20 },
  { SLIDER_CreateIndirect,   NULL,     GUI_ID_SLIDER1, 10, 170, 150,  30 }
};



void show_setting_dialog1()
{
   
   GUI_ExecDialogBox(_aDialogCreate1, GUI_COUNTOF(_aDialogCreate1), &_cbCallback1, 0, 0, 0);
}












//$$$$$$$$$$$$$$$$$$$$$$$$$$$$$$$$$$$$$$$$$$$$$$$$$$$$$$$$$$$$$$$$$$$$$$$$$$$//
//$$$$$$$$$$$$$$$$$$$$$$$$$$$$$$$$$$$$$$$$$$$$$$$$$$$$$$$$$$$$$$$$$$$$$$$$$$$//
//$$$$$$$$$$$$$$$$$$$$$$$$$$$$$$$$$$$$$$$$$$$$$$$$$$$$$$$$$$$$$$$$$$$$$$$$$$$//

/*********************************************************************
*
*       Dialog resource
*
* This table conatins the info required to create the dialog.
* It has been created manually, but could also be created by a GUI-builder.
*/
static const GUI_WIDGET_CREATE_INFO _aDialogCreate2[] = {
  { FRAMEWIN_CreateIndirect, "Setting", 0,         10,  10, 220, 300 , FRAMEWIN_CF_MOVEABLE},
  
  { TEXT_CreateIndirect,     "speed (km/h):" , 0,        70,  3,  100,  20, TEXT_CF_LEFT },
  { TEXT_CreateIndirect,     "flat:" , 0,                5,  25,  35,  20, TEXT_CF_LEFT },
  { TEXT_CreateIndirect,     "slosh:", 0,                5,  55,  35,  20, TEXT_CF_LEFT },
  { TEXT_CreateIndirect,     "unflat:",  0,              5,  85,  35,  20, TEXT_CF_LEFT },
  
  
  { TEXT_CreateIndirect,     "height (m):" , 0,          70,  115,  100, 20, TEXT_CF_LEFT },
  { TEXT_CreateIndirect,     "flat:" ,  0,               5,  135,  35,  20, TEXT_CF_LEFT },
  { TEXT_CreateIndirect,     "slosh:", 0,                5,  165,  35,  20, TEXT_CF_LEFT },
  { TEXT_CreateIndirect,     "unflat:",  0,              5,  195,  35,  20, TEXT_CF_LEFT },


////////
  //{ TEXT_CreateIndirect,     "Preview",0,              205,   4,  81,  15, TEXT_CF_HCENTER },
  { SLIDER_CreateIndirect,   NULL,     GUI_ID_SLIDER0,  40,  20, 115,  20 },
  { SLIDER_CreateIndirect,   NULL,     GUI_ID_SLIDER1,  40,  50, 115,  20 },
  { SLIDER_CreateIndirect,   NULL,     GUI_ID_SLIDER2,  40,  80, 115,  20 },
  
  { SLIDER_CreateIndirect,   NULL,     GUI_ID_SLIDER3,  40,  135, 115,  20 },
  { SLIDER_CreateIndirect,   NULL,     GUI_ID_SLIDER4,  40,  165, 115,  20 },
  { SLIDER_CreateIndirect,   NULL,     GUI_ID_SLIDER5,  40,  195, 115,  20 },
  
  
  
  /////////
  { EDIT_CreateIndirect,     NULL,     GUI_ID_EDIT0,   160,  20,  30,  20, 0, 3 },
  { EDIT_CreateIndirect,     NULL,     GUI_ID_EDIT1,   160,  50,  30,  20, 0, 3 },
  { EDIT_CreateIndirect,     NULL,     GUI_ID_EDIT2,   160,  80,  30,  20, 0, 3 },
  
  { EDIT_CreateIndirect,     NULL,     GUI_ID_EDIT3,   160,  135,  30,  20, 0, 3 },
  { EDIT_CreateIndirect,     NULL,     GUI_ID_EDIT4,   160,  165,  30,  20, 0, 3 },
  { EDIT_CreateIndirect,     NULL,     GUI_ID_EDIT5,   160,  195,  30,  20, 0, 3 },
  
  { CHECKBOX_CreateIndirect, NULL,     GUI_ID_CHECK0,  10, 220,   0,   0 },  
  { TEXT_CreateIndirect,     "alarm on/off",  0, 35,  220,  80,  20, TEXT_CF_LEFT },
 
  { BUTTON_CreateIndirect,   "OK",     GUI_ID_OK,       15, 240,  60,  20 },
  { BUTTON_CreateIndirect,   "Cancel", GUI_ID_CANCEL,   90, 240,  60,  20 },
};





U16 tem_hightest_speed_pingtan ;
U16 tem_hightest_speed_ningling ;
U16 tem_hightest_speed_kanke ;

U16 tem_height_pingtan;
U16 tem_height_ningling ;
U16 tem_height_kanke ;

 
/*********************************************************************
*
*       _OnValueChanged
*/
static void _OnValueChanged(WM_HWIN hDlg, int Id) {
  unsigned Index, v;
  WM_HWIN hSlider, hEdit,hCheck;
  
  
/*  
    if(Id == GUI_ID_CHECK0)
  {
  	hCheck = WM_GetDialogItem(hDlg, GUI_ID_CHECK0);
  	Uart_Printf("T");
  	//alarm_on = CHECKBOX_IsChecked(hCheck);
  	alarm_on = !alarm_on ;
  	
  }
*/

  //拖滑动条
  if ((Id >= GUI_ID_SLIDER0) && (Id <= GUI_ID_SLIDER5)) 
  {
    Index = Id - GUI_ID_SLIDER0;
    /* SLIDER-widget has changed, update EDIT-widget */
    hSlider = WM_GetDialogItem(hDlg, GUI_ID_SLIDER0 + Index);
    hEdit   = WM_GetDialogItem(hDlg, GUI_ID_EDIT0 + Index);
    v = SLIDER_GetValue(hSlider);
    EDIT_SetValue(hEdit, v);
  } 
  
  //从键盘输入
  else if ((Id >= GUI_ID_EDIT0) && (Id <= GUI_ID_EDIT5)) 
  {
    Index = Id - GUI_ID_EDIT0;
    /* If EDIT-widget has changed, update SLIDER-widget */
    hSlider = WM_GetDialogItem(hDlg, GUI_ID_SLIDER0 + Index);
    hEdit   = WM_GetDialogItem(hDlg, GUI_ID_EDIT0 + Index);
    v = EDIT_GetValue(hEdit);
    SLIDER_SetValue(hSlider, v);
  }
  
  
   switch (Index)
	{
		case 0: {tem_hightest_speed_pingtan = v; break;}
		case 1: {tem_hightest_speed_ningling = v; break;}
		case 2: {tem_hightest_speed_kanke = v; break;}
		
		case 3: {tem_height_pingtan = v; break;}
		case 4: {tem_height_ningling = v; break;}
		case 5: {tem_height_kanke = v; break;}
		
		default: break; 
	}
  //_aColorSep[Index] = v;
  /* At last invalidate dialog client window */
  WM_InvalidateWindow(WM_GetClientWindow(hDlg));
}









/*********************************************************************
*
*       Dialog callback routine
*/
static void _cbCallback2(WM_MESSAGE * pMsg) {
  int i;
  int NCode, Id;
  WM_HWIN hDlg, hItem,hCheck;
  hDlg = pMsg->hWin;
  switch (pMsg->MsgId) 
  {
    case WM_PAINT:
      //_OnPaint(hDlg);
      return;
      
    case WM_INIT_DIALOG:
    
      	//WM_SelectWindow(20);
      	//GUI_DispString("UCOSMain");
      	//while(1);
        //hItem = WM_GetDialogItem(hDlg, 20);
        //TEXT_SetFont(hItem, &GUI_FontHZ16);
        //TEXT_SetText(hItem, "你好");
        
        /* Init EDIT-widgets */
  
      if(alarm_on){CHECKBOX_Check(WM_GetDialogItem(hDlg, GUI_ID_CHECK0));}//select
	  else		  {CHECKBOX_Uncheck(WM_GetDialogItem(hDlg, GUI_ID_CHECK0));}//select
	  
      for (i = 0; i < 6; i++) 
      {
        hItem = WM_GetDialogItem(hDlg, GUI_ID_SLIDER0 + i);
        SLIDER_SetRange(hItem, 0, 120);
        SLIDER_SetValue(hItem, 60);
        /* Init EDIT-widgets */
        hItem = WM_GetDialogItem(hDlg, GUI_ID_EDIT0 + i);
        EDIT_SetDecMode(hItem, 60,   0, 120, 0, 0);
      }
      
      //GUI_ID_SLIDER0
    	hItem = WM_GetDialogItem(hDlg, GUI_ID_SLIDER0 );
        SLIDER_SetRange(hItem, 2, 10);
        SLIDER_SetValue(hItem, 5);
   
        hItem = WM_GetDialogItem(hDlg, GUI_ID_EDIT0 );
        EDIT_SetDecMode(hItem, 5,   2, 10, 0, 0);    
      
      //GUI_ID_SLIDER1
      	hItem = WM_GetDialogItem(hDlg, GUI_ID_SLIDER1 );
        SLIDER_SetRange(hItem, 5, 13);
        SLIDER_SetValue(hItem, 9);
       
        hItem = WM_GetDialogItem(hDlg, GUI_ID_EDIT1 );
        EDIT_SetDecMode(hItem, 9,   5, 13, 0, 0);      
      
      
      
      
      
      for (i = 3; i < 6; i++) 
      {
        hItem = WM_GetDialogItem(hDlg, GUI_ID_SLIDER0 + i);
        SLIDER_SetRange(hItem, 0, 50);
        SLIDER_SetValue(hItem, 30);
       
        /* Init EDIT-widgets */
        hItem = WM_GetDialogItem(hDlg, GUI_ID_EDIT0 + i);
        EDIT_SetDecMode(hItem, 30,   0, 50, 0, 0);
      }
      
  
  	    hItem = WM_GetDialogItem(hDlg, GUI_ID_SLIDER0 + 4);
        SLIDER_SetRange(hItem, 0, 50);
        SLIDER_SetValue(hItem, 9);
       
        /* Init EDIT-widgets */
        hItem = WM_GetDialogItem(hDlg, GUI_ID_EDIT0 + 4);
        EDIT_SetDecMode(hItem, 9,   0, 50, 0, 0);
	
      
      break;
   /*   
    case WM_KEY:
      switch (((WM_KEY_INFO*)(pMsg->Data.p))->Key) 
      {
        case GUI_ID_ESCAPE:
          ;
          break;
        case GUI_ID_ENTER:
          GUI_EndDialog(hDlg, 0);
          break;
      }
      break;
    */  
    case WM_NOTIFY_PARENT:
      Id    = WM_GetId(pMsg->hWinSrc);      /* Id of widget */
      NCode = pMsg->Data.v;                 /* Notification code */
      switch (NCode) 
      {
        case WM_NOTIFICATION_RELEASED:      /* React only if released */
          if (Id == GUI_ID_OK)
          {            /* OK Button */
          
          
 			//updata para
			 hightest_speed_pingtan = tem_hightest_speed_pingtan ;
		 	 hightest_speed_ningling = tem_hightest_speed_ningling ;
		 	 hightest_speed_kanke = tem_hightest_speed_kanke ;

			 height_pingtan = tem_height_pingtan;
			 height_ningling = tem_height_ningling ;
			 height_kanke = tem_height_kanke ;
			 
			 
             GUI_EndDialog(hDlg, 0);
             TouchXY.TouchX = TouchXY.TouchY = 0;
		     i_menu = 0;      
          }
          
          
          if (Id == GUI_ID_CANCEL)
          {        /* Cancel Button */
            GUI_EndDialog(hDlg, 1);
            TouchXY.TouchX = TouchXY.TouchY = 0;
		    i_menu = 0;      
          }
          
           if(Id == GUI_ID_CHECK0)
			{
  			hCheck = WM_GetDialogItem(hDlg, GUI_ID_CHECK0);
  			alarm_on = CHECKBOX_IsChecked(hCheck);

 			 }

          break;
          
        case WM_NOTIFICATION_VALUE_CHANGED: /* Value has changed */
          _OnValueChanged(hDlg, Id);
          
          break;
      }
      break;
    default:
      WM_DefaultProc(pMsg);
  }
}





void show_setting_dialog2()
{
   
	GUI_ExecDialogBox(_aDialogCreate2, GUI_COUNTOF(_aDialogCreate2), &_cbCallback2, 0, 0, 0);
}

//$$$$$$$$$$$$$$$$$$$$$$$$$$$$$$$$$$$$$$$$$$$$$$$$$$$$$$$$$$$$$$$$$$$$$$$$$$$//
//$$$$$$$$$$$$$$$$$$$$$$$$$$$$$$$$$$$$$$$$$$$$$$$$$$$$$$$$$$$$$$$$$$$$$$$$$$$//
//$$$$$$$$$$$$$$$$$$$$$$$$$$$$$$$$$$$$$$$$$$$$$$$$$$$$$$$$$$$$$$$$$$$$$$$$$$$//



//$$$$$$$$$$$$$$$$$$$$$$$$$$$$$$$$$$$$$$$$$$$$$$$$$$$$$$$$$$$$$$$$$$$$$$$$$$$//
//$$$$$$$$$$$$$$$$$$$$$$$$$$$$$$$$$$$$$$$$$$$$$$$$$$$$$$$$$$$$$$$$$$$$$$$$$$$//
//$$$$$$$$$$$$$$$$$$$$$$$$$$$$$$$$$$$$$$$$$$$$$$$$$$$$$$$$$$$$$$$$$$$$$$$$$$$//


void Temp_Messagebox(void) 
{

  GUI_MessageBox("Current temperature is\n            36.2 'C",
                 "Temperature(simulate)", 
                 GUI_MESSAGEBOX_CF_MOVEABLE);
 

}


//$$$$$$$$$$$$$$$$$$$$$$$$$$$$$$$$$$$$$$$$$$$$$$$$$$$$$$$$$$$$$$$$$$$$$$$$$$$//
//$$$$$$$$$$$$$$$$$$$$$$$$$$$$$$$$$$$$$$$$$$$$$$$$$$$$$$$$$$$$$$$$$$$$$$$$$$$//
//$$$$$$$$$$$$$$$$$$$$$$$$$$$$$$$$$$$$$$$$$$$$$$$$$$$$$$$$$$$$$$$$$$$$$$$$$$$//

void Weight_Messagebox(void) 
{

  GUI_MessageBox("Current weight is\n            800 kg",
                 "Weight(simulate)", 
                 GUI_MESSAGEBOX_CF_MOVEABLE);
 

}


//$$$$$$$$$$$$$$$$$$$$$$$$$$$$$$$$$$$$$$$$$$$$$$$$$$$$$$$$$$$$$$$$$$$$$$$$$$$//
//$$$$$$$$$$$$$$$$$$$$$$$$$$$$$$$$$$$$$$$$$$$$$$$$$$$$$$$$$$$$$$$$$$$$$$$$$$$//
//$$$$$$$$$$$$$$$$$$$$$$$$$$$$$$$$$$$$$$$$$$$$$$$$$$$$$$$$$$$$$$$$$$$$$$$$$$$//

void return_Messagebox(void) 
{

  GUI_MessageBox("There is no return here",
                 "!!!", 
                 GUI_MESSAGEBOX_CF_MOVEABLE);
 

}
//$$$$$$$$$$$$$$$$$$$$$$$$$$$$$$$$$$$$$$$$$$$$$$$$$$$$$$$$$$$$$$$$$$$$$$$$$$$//
//$$$$$$$$$$$$$$$$$$$$$$$$$$$$$$$$$$$$$$$$$$$$$$$$$$$$$$$$$$$$$$$$$$$$$$$$$$$//
//$$$$$$$$$$$$$$$$$$$$$$$$$$$$$$$$$$$$$$$$$$$$$$$$$$$$$$$$$$$$$$$$$$$$$$$$$$$//

void not_use_Messagebox(void) 
{

  GUI_MessageBox("This menu is unused current",
                 "Sorry", 
                 GUI_MESSAGEBOX_CF_MOVEABLE);
 

}

//$$$$$$$$$$$$$$$$$$$$$$$$$$$$$$$$$$$$$$$$$$$$$$$$$$$$$$$$$$$$$$$$$$$$$$$$$$$//
//$$$$$$$$$$$$$$$$$$$$$$$$$$$$$$$$$$$$$$$$$$$$$$$$$$$$$$$$$$$$$$$$$$$$$$$$$$$//
//$$$$$$$$$$$$$$$$$$$$$$$$$$$$$$$$$$$$$$$$$$$$$$$$$$$$$$$$$$$$$$$$$$$$$$$$$$$//



 void tankProgBar(void) 
 {
  
  PROGBAR_Handle ahProgBar;
  GUI_SetBkColor(GUI_BLUE);
  GUI_ClearRect(10, 10, 230, 140);
  GUI_SetFont(&GUI_FontHZ16);
  GUI_SetColor(GUI_WHITE);
  GUI_DispStringAt("当前油量:",30,35);
  /* Create progress bar */  
  
   GUI_SetColor(GUI_BROWN);
   GUI_SetFont(&GUI_Font8x9);
   GUI_DispStringAt("simulate",10,10);

 
  ahProgBar = PROGBAR_Create(30, 65, 170, 30, WM_CF_SHOW);
  PROGBAR_SetBarColor(ahProgBar, 0, GUI_GREEN);
  PROGBAR_SetBarColor(ahProgBar, 1, GUI_GRAY);

  
  /* Modify progress bar */
    PROGBAR_SetValue(ahProgBar, 86);
    GUI_Exec();
    
    while(0 == TouchXY.TouchX);
  /* Delete progress bar */  
  PROGBAR_Delete(ahProgBar);
  GUI_SetBkColor(GUI_BLACK);
  //GUI_ClearRect(0, 50, 319, 239);
 
}

//$$$$$$$$$$$$$$$$$$$$$$$$$$$$$$$$$$$$$$$$$$$$$$$$$$$$$$$$$$$$$$$$$$$$$$$$$$$//
//$$$$$$$$$$$$$$$$$$$$$$$$$$$$$$$$$$$$$$$$$$$$$$$$$$$$$$$$$$$$$$$$$$$$$$$$$$$//
//$$$$$$$$$$$$$$$$$$$$$$$$$$$$$$$$$$$$$$$$$$$$$$$$$$$$$$$$$$$$$$$$$$$$$$$$$$$//



static const GUI_POINT aPoints[] = {
  {-50,  0},
  {-10, 10},
  {  0, 50},
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  {-10,-10}
};

#define SIZE_OF_ARRAY(Array) (sizeof(Array) / sizeof(Array[0]))

typedef struct {
  int XPos_Poly, YPos_Poly;
  int XPos_Text, YPos_Text;
  GUI_POINT aPointsDest[8];
} tDrawItContext;

/*******************************************************************
*
*                 Drawing routine
*
********************************************************************
*/
extern U8 dis_rev;
static void DrawIt(void * pData) {

  tDrawItContext * pDrawItContext = (tDrawItContext *)pData;
  //GUI_Clear();
 
  GUI_ClearRect(0, 100, 240, 270);
   //GUI_MEMDEV_Handle hMem = GUI_MEMDEV_Create(70, 100, 200, 200);
   //GUI_MEMDEV_Select(hMem); /* Routes the drawing operations to the memory device */
   //GUI_Clear();
  //GUI_SetFont(&GUI_Font8x8);
  //GUI_SetTextMode(GUI_TM_TRANS);
  /* draw background */
  
  if((3 != dis_rev)&&(4 != dis_rev))//平坦路
  {
 // GUI_SetColor(GUI_WHITE); 
 // GUI_DispStringAt("平坦", 100, 40);
  GUI_SetColor(GUI_GREEN);
  GUI_FillRect(pDrawItContext->XPos_Text, 
               pDrawItContext->YPos_Text + 55,
               pDrawItContext->XPos_Text + 50,
               pDrawItContext->YPos_Text + 65);
  /* draw polygon */
  GUI_SetColor(GUI_BLUE);
  GUI_FillPolygon(pDrawItContext->aPointsDest, SIZE_OF_ARRAY(aPoints), 140,  155);
  GUI_DrawCircle(140,155,50);
  /* draw foreground */
  
  GUI_SetColor(GUI_RED);
  GUI_FillRect(100 + pDrawItContext->XPos_Text, 
               pDrawItContext->YPos_Text + 55,
               100 + pDrawItContext->XPos_Text + 50,
               pDrawItContext->YPos_Text + 65);
               
   GUI_SetColor(GUI_WHITE);            
   GUI_FillRect(200 + pDrawItContext->XPos_Text, 
               pDrawItContext->YPos_Text + 55,
               200 + pDrawItContext->XPos_Text + 50,
               pDrawItContext->YPos_Text + 65);

   GUI_SetColor(GUI_MAGENTA);            
   GUI_FillRect(pDrawItContext->XPos_Text - 100, 
               pDrawItContext->YPos_Text + 55,
                pDrawItContext->XPos_Text - 50,
               pDrawItContext->YPos_Text + 65);
	}
	
	
	
	
	  if(3 == dis_rev)//泥泞路
    {
     // GUI_SetColor(GUI_WHITE); 
     // GUI_DispStringAt("泥泞", 100, 40);
      //GUI_SetColor(GUI_GREEN);
 	  //GUI_FillRect(pDrawItContext->XPos_Text, 
               pDrawItContext->YPos_Text + 25,
               pDrawItContext->XPos_Text + 50,
               pDrawItContext->YPos_Text + 35;
  /* draw polygon */
  GUI_SetColor(GUI_BLUE);
  GUI_FillPolygon(pDrawItContext->aPointsDest, SIZE_OF_ARRAY(aPoints), 140,  155);
  GUI_DrawCircle(140,155,50);
  /* draw foreground */
  
  GUI_SetColor(GUI_RED);
  GUI_FillRect(100 + pDrawItContext->XPos_Text, 
               pDrawItContext->YPos_Text + 25,
               100 + pDrawItContext->XPos_Text + 50,
               pDrawItContext->YPos_Text + 35);
               
   GUI_SetColor(GUI_WHITE);            
   GUI_FillRect(200 + pDrawItContext->XPos_Text, 
               pDrawItContext->YPos_Text + 25,
               200 + pDrawItContext->XPos_Text + 50,
               pDrawItContext->YPos_Text + 35);

   GUI_SetColor(GUI_MAGENTA);            
   GUI_FillRect(pDrawItContext->XPos_Text - 100, 
               pDrawItContext->YPos_Text + 25,
                pDrawItContext->XPos_Text - 50,
               pDrawItContext->YPos_Text + 35);
    
    }
	
	if(4 == dis_rev) //坎坷路
   {
    // GUI_SetColor(GUI_WHITE); 
     //GUI_DispStringAt("坎坷", 100, 40);
 	  GUI_FillRect(pDrawItContext->XPos_Text, 
               pDrawItContext->YPos_Text + 75,
               pDrawItContext->XPos_Text + 50,
               pDrawItContext->YPos_Text + 85);
  /* draw polygon */
  GUI_SetColor(GUI_BLUE);
  GUI_FillPolygon(pDrawItContext->aPointsDest, SIZE_OF_ARRAY(aPoints), 140,  155);
  GUI_DrawCircle(140,155,50);
  /* draw foreground */
  
  GUI_SetColor(GUI_RED);
  GUI_FillRect(100 + pDrawItContext->XPos_Text, 
               pDrawItContext->YPos_Text + 25,
               100 + pDrawItContext->XPos_Text + 50,
               pDrawItContext->YPos_Text + 35);
               
   GUI_SetColor(GUI_WHITE);            
   GUI_FillRect(200 + pDrawItContext->XPos_Text, 
               pDrawItContext->YPos_Text + 75,
               200 + pDrawItContext->XPos_Text + 50,
               pDrawItContext->YPos_Text + 85);

   GUI_SetColor(GUI_MAGENTA);            
   GUI_FillRect(pDrawItContext->XPos_Text - 100, 
               pDrawItContext->YPos_Text + 25,
                pDrawItContext->XPos_Text - 50,
               pDrawItContext->YPos_Text + 35);
    
     }
    //GUI_MEMDEV_CopyToLCDAA(hMem);   
   //GUI_MEMDEV_Delete(hMem); /* Destroy memory device */         
}

/*******************************************************************
*
*           Demonstrates the banding memory device
*
********************************************************************
*/

void DemoBandingMemdev(void) {
  int i;
  int XSize = LCD_GET_XSIZE();
  int YSize = LCD_GET_YSIZE();
  
  tDrawItContext DrawItContext;
  GUI_SetFont(&GUI_FontHZ16);
  GUI_SetColor(GUI_WHITE);
  GUI_DispStringHCenterAt("实时路况模拟:", 
                          XSize / 2, 10);
                          
  GUI_DispStringAt("当前路况:", 20, 40);                          
  GUI_SetColor(GUI_GREEN);                        
  //GUI_DispStringAt("平坦", 100, 40);
  
                            
  DrawItContext.XPos_Poly = XSize / 2;
  DrawItContext.YPos_Poly = YSize / 2;
  DrawItContext.YPos_Text = YSize / 2 - 4;
 
  GUI_SetBkColor(GUI_BLACK);
  while(6 == i_menu )
  {
  for (i = 0; i < (XSize - 100); i++) {
    float angle = i * 3.1415926 / 60;
    DrawItContext.XPos_Text = i;
    /* Rotate the polygon */
    GUI_RotatePolygon(DrawItContext.aPointsDest, 
                      aPoints, 
                      SIZE_OF_ARRAY(aPoints), angle);
      /* Simple drawing without using memory devices */
         DrawIt((void *)&DrawItContext);
     OSTimeDly(1);
     check_return_to_main_menu();
     if(i_menu == 0) break;
  }
  }
}




//$$$$$$$$$$$$$$$$$$$$$$$$$$$$$$$$$$$$$$$$$$$$$$$$$$$$$$$$$$$$$$$$$$$$$$$$$$$//
//$$$$$$$$$$$$$$$$$$$$$$$$$$$$$$$$$$$$$$$$$$$$$$$$$$$$$$$$$$$$$$$$$$$$$$$$$$$//
//$$$$$$$$$$$$$$$$$$$$$$$$$$$$$$$$$$$$$$$$$$$$$$$$$$$$$$$$$$$$$$$$$$$$$$$$$$$//
extern volatile int  count_pingtan ;
extern volatile int  count_nining ;
extern volatile int  count_kanke ;
extern volatile float  steady ;

 void rizhi() {
 
  int i;
  float per;
  PROGBAR_Handle ahProgBar[4];

  GUI_SetColor(GUI_WHITE);
  GUI_SetFont(&GUI_FontHZ16);
  GUI_DispStringAt("平坦路", 20,25);
  GUI_DispStringAt("泥泞路", 20,55);
  GUI_DispStringAt("坎坷路", 20,85);
  
  GUI_SetColor(GUI_CYAN);
  GUI_DispStringAt("最高速度:", 20,150);
  GUI_DispStringAt("平均速度:", 20,200);
  GUI_DispStringAt("汽车平稳度:", 20,250);

  GUI_DispStringAt("km/h" , 180, 150 );
  GUI_DispStringAt("km/h" , 180, 200 );
   GUI_DispStringAt("%" , 180, 250 );
  
  for (i=0; i<=2; i++)
  {
  /* Create the progbars */  
  ahProgBar[i] = PROGBAR_Create(80 ,25 + 30*i,135,20, WM_CF_SHOW);
  
  PROGBAR_SetBarColor(ahProgBar[i], 0, GUI_BLUE);
  PROGBAR_SetBarColor(ahProgBar[i], 1, GUI_GRAY);
  PROGBAR_SetMinMax(ahProgBar[i], 0, 100);

  /* Use memory device (optional, for better looks) */
  PROGBAR_EnableMemdev(ahProgBar[i]);
  }
  
  ahProgBar[3] = PROGBAR_Create(20 ,290,195,10, WM_CF_SHOW);
  PROGBAR_SetBarColor(ahProgBar[3], 0, GUI_GREEN);
  PROGBAR_SetBarColor(ahProgBar[3], 1, GUI_GRAY);
  PROGBAR_EnableMemdev(ahProgBar[3]);
  
  
  while(0 == TouchXY.TouchX)
  {
  
  per = ((float)count_pingtan / (float)(count_pingtan + count_nining + count_kanke)) * 100;
  PROGBAR_SetValue(ahProgBar[0], per);
  steady = per ;
  
  per = ((float)count_nining / (float)(count_pingtan + count_nining + count_kanke)) * 100;
  PROGBAR_SetValue(ahProgBar[1], per);
  steady = steady + per * 0.3;
  
  per = ((float)count_kanke / (float)(count_pingtan + count_nining + count_kanke)) * 100;
  PROGBAR_SetValue(ahProgBar[2], per);
  steady = steady + per * 0.1;
  
  if(steady > 50)PROGBAR_SetBarColor(ahProgBar[3], 0, GUI_GREEN);
  else PROGBAR_SetBarColor(ahProgBar[3], 0, GUI_RED);
  PROGBAR_SetValue(ahProgBar[3], steady);
  GUI_Exec();
  
  
  }

  PROGBAR_Delete(ahProgBar[0]);
  PROGBAR_Delete(ahProgBar[1]);
  PROGBAR_Delete(ahProgBar[2]);
  PROGBAR_Delete(ahProgBar[3]);
   
}


//$$$$$$$$$$$$$$$$$$$$$$$$$$$$$$$$$$$$$$$$$$$$$$$$$$$$$$$$$$$$$$$$$$$$$$$$$$$//
//$$$$$$$$$$$$$$$$$$$$$$$$$$$$$$$$$$$$$$$$$$$$$$$$$$$$$$$$$$$$$$$$$$$$$$$$$$$//
//$$$$$$$$$$$$$$$$$$$$$$$$$$$$$$$$$$$$$$$$$$$$$$$$$$$$$$$$$$$$$$$$$$$$$$$$$$$//


extern volatile U8 speed_front_on ;
extern volatile U8 dahua_on ;
extern volatile U8 baosi_on ;
extern volatile U8 kanke_on ;
extern volatile U8 nining_on ;



static const GUI_WIDGET_CREATE_INFO _aDialogCreate3[] = {
  { FRAMEWIN_CreateIndirect, "Setting on/off", 0,         10,  10, 220, 300 , FRAMEWIN_CF_MOVEABLE},
  
 
  { TEXT_CreateIndirect,     "show front_speed" , 0,                25,  25,  90,  20, TEXT_CF_LEFT },
  { TEXT_CreateIndirect,     "dahua  on/off", 0,                25,  55,  80,  20, TEXT_CF_LEFT },
  { TEXT_CreateIndirect,     "baosi  on/off",  0,              25,  85,  80,  20, TEXT_CF_LEFT },
  { TEXT_CreateIndirect,     "kanke  on/off" ,  0,               25,  115,  80,  20, TEXT_CF_LEFT },
  { TEXT_CreateIndirect,     "nining on/off", 0,                25,  145,  80,  20, TEXT_CF_LEFT },
  

  { CHECKBOX_CreateIndirect, NULL,     GUI_ID_CHECK1,  140, 25,   0,   0 },  
  { CHECKBOX_CreateIndirect, NULL,     GUI_ID_CHECK2,  140, 55,   0,   0 },  
  { CHECKBOX_CreateIndirect, NULL,     GUI_ID_CHECK3,  140, 85,   0,   0 },  
  { CHECKBOX_CreateIndirect, NULL,     GUI_ID_CHECK4,  140, 115,   0,   0 },  
  { CHECKBOX_CreateIndirect, NULL,     GUI_ID_CHECK5,  140, 145,   0,   0 }, 
  { BUTTON_CreateIndirect,   "OK",     GUI_ID_OK,       35, 220,  70,  30 },
  { BUTTON_CreateIndirect,   "Cancel", GUI_ID_CANCEL,   130, 220,  70,  30 },
} ;





static void _OnValueChanged3(WM_HWIN hDlg, int Id) 
{
  unsigned Index, v;
  WM_HWIN hCheck;
  

  WM_InvalidateWindow(WM_GetClientWindow(hDlg));
}



/*********************************************************************
*
*       Dialog callback routine
*/

static void _cbCallback3(WM_MESSAGE * pMsg) {
  int i;
  int NCode, Id;
  WM_HWIN hDlg, hItem,hCheck;
  hDlg = pMsg->hWin;
  switch (pMsg->MsgId) 
  {
    case WM_PAINT:
     
    return;
    break;
    
    case WM_INIT_DIALOG:
    
        /* Init EDIT-widgets */
      if(speed_front_on){CHECKBOX_Check(WM_GetDialogItem(hDlg, GUI_ID_CHECK1));}//select
	  else		  {CHECKBOX_Uncheck(WM_GetDialogItem(hDlg, GUI_ID_CHECK1));}
	  
      if(dahua_on){CHECKBOX_Check(WM_GetDialogItem(hDlg, GUI_ID_CHECK2));}//select
	  else		  {CHECKBOX_Uncheck(WM_GetDialogItem(hDlg, GUI_ID_CHECK2));}

      if(baosi_on){CHECKBOX_Check(WM_GetDialogItem(hDlg, GUI_ID_CHECK3));}//select
	  else		  {CHECKBOX_Uncheck(WM_GetDialogItem(hDlg, GUI_ID_CHECK3));}

      if(kanke_on){CHECKBOX_Check(WM_GetDialogItem(hDlg, GUI_ID_CHECK4));}//select
	  else		  {CHECKBOX_Uncheck(WM_GetDialogItem(hDlg, GUI_ID_CHECK4));}

      if(nining_on){CHECKBOX_Check(WM_GetDialogItem(hDlg, GUI_ID_CHECK5));}//select
	  else		  {CHECKBOX_Uncheck(WM_GetDialogItem(hDlg, GUI_ID_CHECK5));
     break;


    case WM_NOTIFY_PARENT:
      Id    = WM_GetId(pMsg->hWinSrc);      /* Id of widget */
      NCode = pMsg->Data.v;                 /* Notification code */
      switch (NCode) 
      {
        case WM_NOTIFICATION_RELEASED:      /* React only if released */
          if (Id == GUI_ID_OK)
          {            /* OK Button */
      						 
             GUI_EndDialog(hDlg, 0);
             TouchXY.TouchX = TouchXY.TouchY = 0;
		     i_menu = 0;      
          }
          
          
          if (Id == GUI_ID_CANCEL)
          {        /* Cancel Button */
            GUI_EndDialog(hDlg, 1);
            TouchXY.TouchX = TouchXY.TouchY = 0;
		    i_menu = 0;      
          }
          
           if(Id == GUI_ID_CHECK1)
			{
  			hCheck = WM_GetDialogItem(hDlg, GUI_ID_CHECK1);
  			speed_front_on= CHECKBOX_IsChecked(hCheck);
 			 }

           if(Id == GUI_ID_CHECK2)
			{
  			hCheck = WM_GetDialogItem(hDlg, GUI_ID_CHECK2);
  			dahua_on= CHECKBOX_IsChecked(hCheck);

 			 }

          if(Id == GUI_ID_CHECK3)
			{
  			hCheck = WM_GetDialogItem(hDlg, GUI_ID_CHECK3);
  			baosi_on= CHECKBOX_IsChecked(hCheck);

 			 }

          if(Id == GUI_ID_CHECK4)
			{
  			hCheck = WM_GetDialogItem(hDlg, GUI_ID_CHECK4);
  			kanke_on= CHECKBOX_IsChecked(hCheck);

 			 }

          if(Id == GUI_ID_CHECK5)
			{
  			hCheck = WM_GetDialogItem(hDlg, GUI_ID_CHECK5);
  			nining_on= CHECKBOX_IsChecked(hCheck);

 			 }


          break;
          }
        case WM_NOTIFICATION_VALUE_CHANGED: /* Value has changed */
          _OnValueChanged3(hDlg, Id);
          
          break;
      }
      break;
    default:
      WM_DefaultProc(pMsg);
  }
}




void show_setting_dialog3()
{
   
	GUI_ExecDialogBox(_aDialogCreate3, GUI_COUNTOF(_aDialogCreate3), &_cbCallback3, 0, 0, 0);
}







